;/* Copyright (c) 2016, The Linux Foundation. All rights reserved.
;*
;* Redistribution and use in source and binary forms, with or without
;* modification, are permitted provided that the following conditions are
;* met:
;* * Redistributions of source code must retain the above copyright
;*  notice, this list of conditions and the following disclaimer.
;*  * Redistributions in binary form must reproduce the above
;* copyright notice, this list of conditions and the following
;* disclaimer in the documentation and/or other materials provided
;*  with the distribution.
;*   * Neither the name of The Linux Foundation nor the names of its
;* contributors may be used to endorse or promote products derived
;* from this software without specific prior written permission.
;*
;* THIS SOFTWARE IS PROVIDED "AS IS" AND ANY EXPRESS OR IMPLIED
;* WARRANTIES, INCLUDING, BUT NOT LIMITED TO, THE IMPLIED WARRANTIES OF
;* MERCHANTABILITY, FITNESS FOR A PARTICULAR PURPOSE AND NON-INFRINGEMENT
;* ARE DISCLAIMED.  IN NO EVENT SHALL THE COPYRIGHT OWNER OR CONTRIBUTORS
;* BE LIABLE FOR ANY DIRECT, INDIRECT, INCIDENTAL, SPECIAL, EXEMPLARY, OR
;* CONSEQUENTIAL DAMAGES (INCLUDING, BUT NOT LIMITED TO, PROCUREMENT OF
;* SUBSTITUTE GOODS OR SERVICES; LOSS OF USE, DATA, OR PROFITS; OR
;* BUSINESS INTERRUPTION) HOWEVER CAUSED AND ON ANY THEORY OF LIABILITY,
;* WHETHER IN CONTRACT, STRICT LIABILITY, OR TORT (INCLUDING NEGLIGENCE
;* OR OTHERWISE) ARISING IN ANY WAY OUT OF THE USE OF THIS SOFTWARE, EVEN
;* IF ADVISED OF THE POSSIBILITY OF SUCH DAMAGE.
;*/

global &UefiCorePath
global &AppObjPath
global &AppSrcPath

local &scanres
local &scanpos

ENTRY

  ; Check if path to UEFI is already defined
  if ("&UefiCorePath"=="")
  (
    dialog.ok "Run script uefi_core_path_set.cmm to set path to UEFI core <TargetPkg>/Tools directory"
    end
  )
  ; Sanity check UEFI path ends with "Tools"
  &scanres=0.
  &scanpos=0.
  &scanpos=string.length("&UefiCorePath")-string.length("Tools")
  &scanres=string.scan("&UefiCorePath", "Tools", &scanpos)
  if (&scanres==-1.)
  (
    dialog.ok "UEFI path is inavalid!" "Run script uefi_core_path_set.cmm to set path to UEFI core <TargetPkg>/Tools directory"
    end
  )

  ; Check if App pkg paths are already defined
  if (("&AppObjPath"=="")||("&AppSrcPath"==""))
  (
    dialog.ok "Run script app_path_set.cmm to set path to AppPkg Src/Obj directories"
    end
  )
  ; Sanity check App Obj Path has "Build" subdirectory
  &path="&AppObjPath/Build"
  if (os.access("&path", "r")!=TRUE())
  (
    dialog.ok "Obj Path does not contain _Build_ subdirectory!" "Run script app_path_set.cmm to set path to AppPkg Src/Obj directories"
    end
  )
  ; Sanity check App Src Path has "MdePkg" subdirectory
  &path="&AppSrcPath/MdePkg"
  if (os.access("&path", "r")!=TRUE())
  (
    dialog.ok "Src Path does not contain _MdePkg_ subdirectory!" "Run script app_path_set.cmm to set path to AppPkg Src/Obj directories"
    end
  )


enddo
